## conf/distro/c444-xwayland.conf
```bitbake
# i.MX DISTRO for Wayland with X11

include conf/distro/include/fsl-imx-base.inc
include conf/distro/include/fsl-imx-preferred-env.inc

DISTRO = "c444-xwayland"

# Remove conflicting backends
DISTRO_FEATURES_remove = "directfb busybox "
DISTRO_FEATURES_append = " x11 wayland pam coreutils util-linux util-linux-hwclock coreutils shadow u-boot-imx-fw-utils systemd "

VIRTUAL-RUNTIME_init_manager = " systemd"
VIRTUAL-RUNTIME_initscripts = ""
VIRTUAL-RUNTIME_syslog = ""
VIRTUAL-RUNTIME_login_manager = "shadow"

PREFERRED_PROVIDER_virtual/base-utils = "coreutils"
VIRTUAL-RUNTIME_base-utils = "coreutils"
VIRTUAL-RUNTIME_base-utils-hwclock = "util-linux-hwclock"
VIRTUAL-RUNTIME_base-utils-syslog = ""

ALTERNATIVE_PRIORITY_pn-busybox = "1"
```

## conf/layer.conf
```bitbake
# We have a conf and classes directory, add to BBPATH
BBPATH .= ":${LAYERDIR}"

# We have a packages directory, add to BBFILES
BBFILES += "${LAYERDIR}/recipes-*/*/*.bb \
            ${LAYERDIR}/recipes-*/*/*.bbappend"

BBFILE_COLLECTIONS += "winsys"
BBFILE_PATTERN_winsys := "^${LAYERDIR}"
BBFILE_PRIORITY_winsys = "11"
LAYERSERIES_COMPAT_winsys = "kirkstone"

HOSTTOOLS_NONFATAL:append = " bc rsync xxd"

DISTRO_FEATURES_FILTER_NATIVESDK += "wayland"

MACHINE_USES_VIVANTE_KERNEL_DRIVER_MODULE ?= "0"

# Overrides for imx-base.inc
#IMAGE_CLASSES += "image_types_create_sdcard_symlink"
KERNEL_DEVICETREE:append:imx8mq-itx-p-c444 = " \
    freescale/imx8mq-itx-p-c444.dtb \
"`  
```

## conf/machine/imx8mq-itx-p-c444.conf
```bitbake
#@TYPE: Machine
#@NAME: WINSYSTEMS ITX-P-C444
#@SOC: i.MX8MQ
#@DESCRIPTION: Machine configuration for WINSYSTEMS ITX-P-C444
#@MAINTAINER:  bherrera@winsystems.com

MACHINEOVERRIDES =. "mx8:mx8m:mx8mq:"

require conf/machine/include/imx-base.inc
require conf/machine/include/arm/armv8a/tune-cortexa53.inc

# Mainline BSP defaults to "generic" cortexa53 configuration,
# adjust it here to include crypto extension which enables
# inline NEON and FPU code generation
DEFAULTTUNE:use-mainline-bsp = "cortexa53-crypto"

MACHINE_FEATURES += " pci wifi bluetooth"

MACHINE_SOCARCH_FILTER:append:mx8mq = " virtual/libopenvg virtual/libgles1 virtual/libgles2 virtual/egl virtual/mesa virtual/libgl virtual/libg2d"

KERNEL_DEVICETREE = "freescale/imx8mq-itx-p-c444.dtb freescale/imx8mq-itx-p-c444-lvds-auo.dtb"

UBOOT_CONFIG ??= "sd"
UBOOT_CONFIG[sd]      = "imx8mq_itx_p_c444_config,sdcard"
UBOOT_CONFIG[mfgtool] = "imx8mq_itx_p_c444_config"
SPL_BINARY = "spl/u-boot-spl.bin"

PREFERRED_PROVIDER_u-boot = "u-boot-imx"

# Set DDR FIRMWARE
DDR_FIRMWARE_NAME = "lpddr4_pmu_train_1d_imem.bin lpddr4_pmu_train_1d_dmem.bin lpddr4_pmu_train_2d_imem.bin lpddr4_pmu_train_2d_dmem.bin"

# Set u-boot DTB
UBOOT_DTB_NAME = "imx8mq-itx-p-c444.dtb"

# Set ATF platform name
ATF_PLATFORM = "imx8mq"

# Extra firmware package name, that is required to build boot container for fslc bsp
IMX_EXTRA_FIRMWARE = "firmware-imx-8m"

# Set imx-mkimage boot target
IMXBOOT_TARGETS = "flash_evk flash_evk_no_hdmi flash_dp_evk"
IMX_BOOT_SOC_TARGET = "iMX8M"

# Set Serial console
SERIAL_CONSOLES = "115200;ttymxc0"

IMAGE_BOOTLOADER = "imx-boot"

BOOT_SPACE = "65536"
LOADADDR = ""
UBOOT_SUFFIX = "bin"
UBOOT_MAKE_TARGET = ""
IMX_BOOT_SEEK = "33"

IMAGE_OVERHEAD_FACTOR = "2.0"

LICENSE_FLAGS_ACCEPTED="commercial"
```

## imx/meta-bsp/conf/layer.conf
```bitbake
# We have a conf and classes directory, add to BBPATH
BBPATH .= ":${LAYERDIR}"

# We have a packages directory, add to BBFILES
BBFILES += "${LAYERDIR}/recipes-*/*/*.bb \
            ${LAYERDIR}/recipes-*/*/*.bbappend"

BBFILE_COLLECTIONS += "winsys-bsp-release"
BBFILE_PATTERN_winsys-bsp-release := "^${LAYERDIR}"
BBFILE_PRIORITY_winsys-bsp-release = "8"
LAYERSERIES_COMPAT_winsys-bsp-release = "sumo"

HOSTTOOLS_NONFATAL_append = " sha384sum xxd"

BBMASK += "meta-freescale/recipes-graphics/clutter/clutter-1.0_%.bbappend"
BBMASK += "meta-freescale/recipes-graphics/cogl/cogl-1.0_%.bbappend"
BBMASK += "meta-freescale/recipes-graphics/mesa/mesa-demos_%.bbappend"
BBMASK += "meta-freescale/recipes-graphics/xorg-driver/xf86-video-imxfb-vivante_5.0.11.p8.6.bb"
BBMASK += "meta-freescale/recipes-graphics/imx-gpu-viv/imx-gpu-viv_5.0.11.p8.6-hfp.bb"
DISTRO_FEATURES_append = " optee"
DISTRO_FEATURES_FILTER_NATIVESDK += "wayland"
```

## imx/meta-bsp/conf/machine/imx8mqpicoitx.conf
```bitbake
#@TYPE: Machine
#@NAME: NXP i.MX8MQ Evaluation Kit
#@SOC: i.MX8MQ
#@DESCRIPTION: Machine configuration for NXP i.MX8MQ EVK
#@MAINTAINER: Jun Zhu <junzhu@nxp.com>

MACHINEOVERRIDES =. "mx8:mx8m:mx8mq:"

require conf/machine/include/imx-base.inc
require conf/machine/include/arm/arch-arm64.inc

MACHINE_FEATURES += " pci wifi bluetooth "

KERNEL_DEVICETREE = "freescale/fsl-imx8mq-picoitx.dtb freescale/fsl-imx8mq-picoitx-lvds-auo.dtb"
KERNEL_DEVICETREE += "freescale/fsl-imx8mq-picoitx-rs485.dtb freescale/fsl-imx8mq-picoitx-lvds-sharp.dtb"
KERNEL_DEVICETREE += "freescale/fsl-imx8mq-picoitx-lvds-auo-small.dtb"

UBOOT_CONFIG ??= "sd"
UBOOT_CONFIG[sd] = "imx8mq_evk_config,sdcard"
UBOOT_CONFIG[mfgtool] = "imx8mq_evk_config"
SPL_BINARY = "spl/u-boot-spl.bin"

# Set DDR FIRMWARE
DDR_FIRMWARE_NAME = "lpddr4_pmu_train_1d_imem.bin lpddr4_pmu_train_1d_dmem.bin lpddr4_pmu_train_2d_imem.bin lpddr4_pmu_train_2d_dmem.bin"

# Set u-boot DTB
UBOOT_DTB_NAME = "fsl-imx8mq-picoitx.dtb"

# Set imx-mkimage boot target
IMXBOOT_TARGETS = "flash_evk flash_evk_no_hdmi"

# Set Serial console
SERIAL_CONSOLE = "115200 ttymxc0"

IMAGE_BOOTLOADER = "imx-boot"

BOOT_SPACE = "65536"

LOADADDR = ""
UBOOT_SUFFIX = "bin"
UBOOT_MAKE_TARGET = ""
IMX_BOOT_SEEK = "33"

IMAGE_OVERHEAD_FACTOR = "2.0"

LICENSE_FLAGS_WHITELIST="commercial"
IMAGE_INSTALL_append = " \
        xrandr \
        fbida \
        iperf3 \
        devmem2 \
        sysstat \
        ffmpeg \
        usb-modeswitch \
        dmidecode \
        hdparm \
        packagegroup-core-buildessential \
        wol-support \
        htop \
        stress-ng \
        glmark2 \
        rpmb-access \
        tmux\
"
```
